## oplus/kernel/device_info/device_info/Kconfig
```kconfig
config OPLUS_DEVICE_INFO
  tristate "config oplus devinfo software"
  help
    define this config to compile devinfo.c for device register

config OPLUS_POGOPIN_FUNCTION
    bool "OPLUS pogopin keyboard module used"
    help
      Say Y here if you have pogopin keyboard.
```
